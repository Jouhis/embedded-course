## prj.conf
```kconfig
# prj.conf holds Kconfig symbols for this application only. Every CONFIG_ line here overrides
# the default of the symbol; anything you leave out keeps the default from Zephyr's Kconfig
# files or from the board's defconfig. Inspect the result in build/zephyr/.config.

CONFIG_GPIO=y
CONFIG_PRINTK=y

# The logging subsystem. Without CONFIG_LOG=y the LOG_* macros compile to nothing.
CONFIG_LOG=y
# 0 = off, 1 = error, 2 = warning, 3 = info, 4 = debug (LOG_DEFAULT_LEVEL range in subsys/logging/Kconfig.filtering).
CONFIG_LOG_DEFAULT_LEVEL=3
# Immediate mode prints each message where it is logged. Deferred mode (the default) queues
# the text and sends it from a thread, which is cheaper for the caller but adds delay.
CONFIG_LOG_MODE_IMMEDIATE=y

# The stack of main(). The default is small, and the logger's printf-style formatting is deep.
CONFIG_MAIN_STACK_SIZE=2048
```

## src/main.c
```c
// EXPECT: KCONFIG OK
/* Blinky with logging. The Kconfig options that turn logging on live in prj.conf, and the
 * LOG_* macros below compile to nothing when CONFIG_LOG is off. */
#include <zephyr/kernel.h>
#include <zephyr/drivers/gpio.h>
#include <zephyr/logging/log.h>
#include <zephyr/sys/printk.h>

/* Each file names its own log module. The level here is the compile-time limit for this file;
 * LOG_DBG lines below it are removed from the binary. */
LOG_MODULE_REGISTER(app, LOG_LEVEL_DBG);

static const struct gpio_dt_spec led = GPIO_DT_SPEC_GET(DT_ALIAS(led0), gpios);

int main(void)
{
    if (!gpio_is_ready_dt(&led)) {
        LOG_ERR("LED device not ready");
        return 0;
    }
    if (gpio_pin_configure_dt(&led, GPIO_OUTPUT_ACTIVE) < 0) {
        LOG_ERR("LED configure failed");
        return 0;
    }

    LOG_INF("KCONFIG OK, blinking every 500 ms");

    while (1) {
        gpio_pin_toggle_dt(&led);
        /* Debug output for every toggle. printk() below is not filtered by log levels. */
        LOG_DBG("LED level now %d", gpio_pin_get_dt(&led));
        printk("LED toggled at %lld ms\n", k_uptime_get());
        k_msleep(500);
    }
    return 0;
}
```
