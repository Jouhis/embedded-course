## CMakeLists.txt
```
cmake_minimum_required(VERSION 3.20.0)
find_package(Zephyr REQUIRED HINTS $ENV{ZEPHYR_BASE})
project(logging_shell)
target_sources(app PRIVATE src/main.c src/temp_format.c)
```

## prj.conf
```kconfig
CONFIG_GPIO=y
CONFIG_PRINTK=y

# The shell is on, so the shell_print() calls in main.c link. Without CONFIG_SHELL=y the
# linker fails with "undefined reference to shell_fprintf_impl", which is a good example of
# a missing Kconfig option (see lesson 99).
CONFIG_SHELL=y
CONFIG_SHELL_BACKEND_SERIAL=y

# TODO(learner): turn on the logger with these two lines, from lesson 99:
#   CONFIG_LOG=y
#   CONFIG_LOG_DEFAULT_LEVEL=3
# and add CONFIG_SHELL_LOG_BACKEND=y so that LOG_INF lines reach the serial monitor.
```

## src/temp_format.c
```c
/* temp_format.c: the MYS-1 count-to-temperature conversion. */
#include "temp_format.h"

/* TODO(learner): return raw * 100 / 64 (hundredths of a degree). Multiply before you divide,
 * so the fraction is kept. Then run the ztest, which checks 1440 -> 2250 and -64 -> -100. */
int32_t mys_raw_to_centi_c(int16_t raw)
{
    (void)raw;
    return 0;
}
```
