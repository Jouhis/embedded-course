/*
 * boards/rpi_pico.overlay: the button for this lesson, on GP14 (pressed = low, pull-up).
  * The binding is in dts/bindings/input/vnd,user-button.yaml. The alias sw0 is what main.c uses.
 */
#include <zephyr/dt-bindings/gpio/gpio.h>

/ {
	buttons {
		user_button: button_0 {
			compatible = "vnd,user-button";
			gpios = <&gpio0 14 (GPIO_ACTIVE_LOW | GPIO_PULL_UP)>;
			label = "Button";
		};
	};

	aliases {
		sw0 = &user_button;
	};
};
